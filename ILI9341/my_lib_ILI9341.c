/**
  ******************************************************************************
  *
  * Author: Pavel Vaner
  *
  ******************************************************************************
  */
/* Includes ------------------------------------------------------------------*/
#include <my_lib_ILI9341.h>
/* Definitions ------------------------------------------------------------------*/
/* Variables ------------------------------------------------------------------*/
extern SPI_HandleTypeDef hspi3;
extern RNG_HandleTypeDef hrng;
static uint8_t rotationNum=1;
static bool _cp437 = false;
static GPIO_TypeDef  *tftCS_GPIO;
static uint16_t tftCS_PIN; //chip select pin
static GPIO_TypeDef  *tftDC_GPIO;
static uint16_t tftDC_PIN; //data command pin
static GPIO_TypeDef  *tftRESET_GPIO;
static uint16_t tftRESET_PIN; //reset pin
uint16_t TFT9341_WIDTH=240;
uint16_t TFT9341_HEIGHT=320;
extern uint8_t dma_spi_fl;
extern uint32_t dma_spi_cnt;
uint8_t frm_buf[65536] = {0};

static //pole jednoducheho textoveho fontu
const unsigned char font1[] = {
	0x00, 0x00, 0x00, 0x00, 0x00,
	0x3E, 0x5B, 0x4F, 0x5B, 0x3E,
	0x3E, 0x6B, 0x4F, 0x6B, 0x3E,
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	0x00, 0x00, 0x00, 0x00, 0x00
};

/* Functions ------------------------------------------------------------------*/
//posli command
void TFT9341_SendCommand(uint8_t cmd)
{
  DC_COMMAND();
  HAL_SPI_Transmit (&hspi3, &cmd, 1, 5000);
}
//posli data
void TFT9341_SendData(uint8_t dt)
{
	DC_DATA();
	HAL_SPI_Transmit (&hspi3, &dt, 1, 5000);
}
//zapis data
static void TFT9341_WriteData(uint8_t* buff, size_t buff_size)
{
	DC_DATA();
	while(buff_size > 0) {
		uint16_t chunk_size = buff_size > 32768 ? 32768 : buff_size;
		HAL_SPI_Transmit(&hspi3, buff, chunk_size, HAL_MAX_DELAY);
		buff += chunk_size;
		buff_size -= chunk_size;
	}
}
//inicializace tft displeje
void TFT9341_Init(GPIO_TypeDef *csPORT, uint16_t csPIN, GPIO_TypeDef *dcPORT, uint16_t dcPIN, GPIO_TypeDef *resetPORT, uint16_t resetPIN)
{
	 //CS pin
	 tftCS_GPIO = csPORT;
	 tftCS_PIN = csPIN;
	 //DC pin
	 tftDC_GPIO = dcPORT;
	 tftDC_PIN = dcPIN;
	 //RESET pin
	 tftRESET_GPIO = resetPORT;
	 tftRESET_PIN = resetPIN;
	  uint8_t data[15];
	  CS_ACTIVE();
	  TFT9341_reset();
	  //Software Reset
	  TFT9341_SendCommand(0x01);
	  HAL_Delay(1000);
	  //Power Control A
	  data[0] = 0x39;
	  data[1] = 0x2C;
	  data[2] = 0x00;
	  data[3] = 0x34;
	  data[4] = 0x02;
	  TFT9341_SendCommand(0xCB);
	  TFT9341_WriteData(data, 5);
	  //Power Control B
	  data[0] = 0x00;
	  data[1] = 0xC1;
	  data[2] = 0x30;
	  TFT9341_SendCommand(0xCF);
	  TFT9341_WriteData(data, 3);
	  //Driver timing control A
	  data[0] = 0x85;
	  data[1] = 0x00;
	  data[2] = 0x78;
	  TFT9341_SendCommand(0xE8);
	  TFT9341_WriteData(data, 3);
	  //Driver timing control B
	  data[0] = 0x00;
	  data[1] = 0x00;
	  TFT9341_SendCommand(0xEA);
	  TFT9341_WriteData(data, 2);
	  //Power on Sequence control
	  data[0] = 0x64;
	  data[1] = 0x03;
	  data[2] = 0x12;
	  data[3] = 0x81;
	  TFT9341_SendCommand(0xED);
	  TFT9341_WriteData(data, 4);
	  //Pump ratio control
	  data[0] = 0x20;
	  TFT9341_SendCommand(0xF7);
	  TFT9341_WriteData(data, 1);
	  //Power Control,VRH[5:0]
	  data[0] = 0x10;
	  TFT9341_SendCommand(0xC0);
	  TFT9341_WriteData(data, 1);
	  //Power Control,SAP[2:0];BT[3:0]
	  data[0] = 0x10;
	  TFT9341_SendCommand(0xC1);
	  TFT9341_WriteData(data, 1);
	  //VCOM Control 1
	  data[0] = 0x3E;
	  data[1] = 0x28;
	  TFT9341_SendCommand(0xC5);
	  TFT9341_WriteData(data, 2);
	  //VCOM Control 2
	  data[0] = 0x86;
	  TFT9341_SendCommand(0xC7);
	  TFT9341_WriteData(data, 1);
	  //Memory Acsess Control
	  data[0] = 0x48;
	  TFT9341_SendCommand(0x36);
	  TFT9341_WriteData(data, 1);
	  //Pixel Format Set
	  data[0] = 0x55;//16bit
	  TFT9341_SendCommand(0x3A);
	  TFT9341_WriteData(data, 1);
	  //Frame Rratio Control, Standard RGB Color
	  data[0] = 0x00;
	  data[1] = 0x18;
	  TFT9341_SendCommand(0xB1);
	  TFT9341_WriteData(data, 2);
	  //Display Function Control
	  data[0] = 0x08;
	  data[1] = 0x82;
	  data[2] = 0x27;//320
	  TFT9341_SendCommand(0xB6);
	  TFT9341_WriteData(data, 3);
	  //Enable 3G
	  data[0] = 0x00;
	  TFT9341_SendCommand(0xF2);
	  TFT9341_WriteData(data, 1);
	  //Gamma set
	  data[0] = 0x01;//Gamma Curve (G2.2)
	  TFT9341_SendCommand(0x26);
	  TFT9341_WriteData(data, 1);
	  //Positive Gamma  Correction
	  data[0] = 0x0F;
	  data[1] = 0x31;
	  data[2] = 0x2B;
	  data[3] = 0x0C;
	  data[4] = 0x0E;
	  data[5] = 0x08;
	  data[6] = 0x4E;
	  data[7] = 0xF1;
	  data[8] = 0x37;
	  data[9] = 0x07;
	  data[10] = 0x10;
	  data[11] = 0x03;
	  data[12] = 0x0E;
	  data[13] = 0x09;
	  data[14] = 0x00;
	  TFT9341_SendCommand(0xE0);
	  TFT9341_WriteData(data, 15);
	  //Negative Gamma  Correction
	  data[0] = 0x00;
	  data[1] = 0x0E;
	  data[2] = 0x14;
	  data[3] = 0x03;
	  data[4] = 0x11;
	  data[5] = 0x07;
	  data[6] = 0x31;
	  data[7] = 0xC1;
	  data[8] = 0x48;
	  data[9] = 0x08;
	  data[10] = 0x0F;
	  data[11] = 0x0C;
	  data[12] = 0x31;
	  data[13] = 0x36;
	  data[14] = 0x0F;
	  TFT9341_SendCommand(0xE1);
	  TFT9341_WriteData(data, 15);
	  TFT9341_SendCommand(0x11);
	  HAL_Delay(120);
	  //Display ON
	  data[0] = 0x48;
	  TFT9341_SendCommand(0x29);
	  TFT9341_WriteData(data, 1);
}
//reset TFT displeje
void TFT9341_reset(void)
{
	RESET_ACTIVE();
	HAL_Delay(5);
	RESET_IDLE();
}
//nastaveni adresy okna kam se bude vykreslovat
static void TFT9341_SetAddrWindow(uint16_t x0, uint16_t y0, uint16_t x1, uint16_t y1)
{
	  // column address set
	  TFT9341_SendCommand(0x2A); // CASET
	  {
	    uint8_t data[] = { (x0 >> 8) & 0xFF, x0 & 0xFF, (x1 >> 8) & 0xFF, x1 & 0xFF };
	    TFT9341_WriteData(data, sizeof(data));
	  }
	  // row address set
	  TFT9341_SendCommand(0x2B); // RASET
	  {
	    uint8_t data[] = { (y0 >> 8) & 0xFF, y0 & 0xFF, (y1 >> 8) & 0xFF, y1 & 0xFF };
	    TFT9341_WriteData(data, sizeof(data));
	  }
	  // write to RAM
	  TFT9341_SendCommand(0x2C); // RAMWR
}
//vybarveni cele obrazovky
void TFT9341_FillScreen(uint16_t color)
{
	  uint32_t i, n;
	  TFT9341_SetAddrWindow(0, 0, TFT9341_WIDTH-1, TFT9341_HEIGHT-1);
	  for(i=0;i<25600;i++)
	  {
	    frm_buf[i*2] = color >> 8;
	    frm_buf[i*2+1] = color & 0xFF;
	  }
	  n = 51200;
	  DC_DATA();
	  dma_spi_cnt = 3;
	  HAL_SPI_Transmit_DMA(&hspi3, frm_buf, n);
	  while(!dma_spi_fl) {}
	  dma_spi_fl=0;
}
//vykresleni obdelniku
void TFT9341_FillRect(uint16_t x1, uint16_t y1, uint16_t x2, uint16_t y2, uint16_t color)
{
	 uint32_t i, n, cnt, buf_size;
		if(x1>x2) swap(x1,x2);
		if(y1>y2) swap(y1,y2);
	  TFT9341_SetAddrWindow(x1, y1, x2, y2);
	  DC_DATA();
	  n = (x2-x1+1)*(y2-y1+1)*2;
	  if(n<=65535)
	  {
	    cnt = 1;
	    buf_size = n;
	  }
	  else
	  {
	    cnt = n/2;
	    buf_size = 2;
	    for(i = 3; i < n/3; i++)
	    {
	      if(n%i == 0)
	      {
	        cnt = i;
	        buf_size = n/i;
	        break;
	      }
	    }
	  }
	  for(i = 0; i < buf_size/2; i++)
	  {
	    frm_buf[i*2] = color >> 8;
	    frm_buf[i*2+1] = color & 0xFF;
	  }
	  dma_spi_cnt = cnt;
	  HAL_SPI_Transmit_DMA(&hspi3, frm_buf, buf_size);
	  while(!dma_spi_fl) {}
	  dma_spi_fl=0;
}
//vykresleni pixelu
void TFT9341_DrawPixel(int x, int y, uint16_t color)
{
	if((x<0)||(y<0)||(x>=TFT9341_WIDTH)||(y>=TFT9341_HEIGHT)) return;
	TFT9341_SetAddrWindow(x,y,x,y);
	TFT9341_SendCommand(0x2C);
	TFT9341_SendData(color>>8);
	TFT9341_SendData(color & 0xFF);
}
//vykresleni kruhu
void TFT9341_DrawCircle(uint16_t x0, uint16_t y0, int r, uint16_t color)
{
	int f = 1-r;
	int ddF_x=1;
	int ddF_y=-2*r;
	int x = 0;
	int y = r;
	TFT9341_DrawPixel(x0,y0+r,color);
	TFT9341_DrawPixel(x0,y0-r,color);
	TFT9341_DrawPixel(x0+r,y0,color);
	TFT9341_DrawPixel(x0-r,y0,color);
	while (x<y)
	{
		if (f>=0)
		{
			y--;
			ddF_y+=2;
			f+=ddF_y;
		}
		x++;
		ddF_x+=2;
		f+=ddF_x;
		TFT9341_DrawPixel(x0+x,y0+y,color);
		TFT9341_DrawPixel(x0-x,y0+y,color);
		TFT9341_DrawPixel(x0+x,y0-y,color);
		TFT9341_DrawPixel(x0-x,y0-y,color);
		TFT9341_DrawPixel(x0+y,y0+x,color);
		TFT9341_DrawPixel(x0-y,y0+x,color);
		TFT9341_DrawPixel(x0+y,y0-x,color);
		TFT9341_DrawPixel(x0-y,y0-x,color);
	}
}
//nastaveni rotace displeje
void TFT9341_SetRotation(uint8_t r)
{
  TFT9341_SendCommand(0x36);
  switch(r)
	{
		case 1:
			  rotationNum = 1;
		      TFT9341_SendData(0x48);
		      TFT9341_WIDTH = 240;
		      TFT9341_HEIGHT = 320;
			break;
		case 2:
			  rotationNum = 2;
		      TFT9341_SendData(0x28);
		      TFT9341_WIDTH = 320;
		      TFT9341_HEIGHT = 240;
			break;
		case 3:
			  rotationNum = 3;
		      TFT9341_SendData(0x88);
		      TFT9341_WIDTH = 240;
		      TFT9341_HEIGHT = 320;
			break;
		case 4:
			  rotationNum = 4;
		      TFT9341_SendData(0xE8);
		      TFT9341_WIDTH = 320;
		      TFT9341_HEIGHT = 240;
			break;
		default:
			  rotationNum = 1;
		      TFT9341_SendData(0x48);
		      TFT9341_WIDTH = 240;
		      TFT9341_HEIGHT = 320;
			break;
	}
}
//vykresleni znaku
void TFT9341_drawChar(int16_t x, int16_t y, unsigned char c, uint16_t color, uint16_t bg, uint8_t size)
{
	if(rotationNum == 2 || rotationNum ==4)
	{
		if((x >= TFT9341_WIDTH) || (y >= TFT9341_HEIGHT) || ((x + 6 * size - 1) < 0) || ((y + 8 * size - 1) < 0))
		{
			return;
		}
	}
	else
	{
		if((y >= TFT9341_WIDTH) || (x >= TFT9341_HEIGHT) || ((y + 6 * size - 1) < 0) || ((x + 8 * size - 1) < 0))
		{
		    return;
		}
	}
  if(!_cp437 && (c >= 176)) c++;

  for (int8_t i=0; i<6; i++ ) {
    uint8_t line;
    if (i == 5)
      line = 0x0;
    else
      line = pgm_read_byte(font1+(c*5)+i);
    for (int8_t j = 0; j<8; j++) {
      if (line & 0x1) {
        if (size == 1) // default size
        	TFT9341_DrawPixel(x+i, y+j, color);
        else {  // big size
        	TFT9341_FillRect(x+(i*size), y+(j*size), size + x+(i*size), size+1 + y+(j*size), color);
        }
      } else if (bg != color) {
        if (size == 1) // default size
        	TFT9341_DrawPixel(x+i, y+j, bg);
        else {  // big size
        	TFT9341_FillRect(x+i*size, y+j*size, size + x+i*size, size+1 + y+j*size, bg);
        }
      }
      line >>= 1;
    }
  }
}
//vykresleni textu
void TFT9341_printText(char text[], int16_t x, int16_t y, uint16_t color, uint16_t bg, uint8_t size)
{
	int16_t offset;
	offset = size*6;
	for(uint16_t i=0; i<40 && text[i]!=NULL; i++)
	{
		TFT9341_drawChar(x+(offset*i), y, text[i],color,bg,size);
	}
}
//vykreslení čáry
void TFT9341_DrawLine(uint16_t color, uint16_t x1, uint16_t y1,	uint16_t x2, uint16_t y2)
{
  int steep = abs(y2-y1)>abs(x2-x1);
  if(steep)
  {
    swap(x1,y1);
    swap(x2,y2);
  }
  if(x1>x2)
  {
    swap(x1,x2);
    swap(y1,y2);
  }
  int dx,dy;
  dx=x2-x1;
  dy=abs(y2-y1);
  int err=dx/2;
  int ystep;
  if(y1<y2) ystep=1;
  else ystep=-1;
  for(;x1<=x2;x1++)
  {
    if(steep) TFT9341_DrawPixel(y1,x1,color);
    else TFT9341_DrawPixel(x1,y1,color);
    err-=dy;
    if(err<0)
    {
      y1 += ystep;
      err=dx;
    }
  }
}
//vykreslení obdelníku
void TFT9341_DrawRect(uint16_t color, uint16_t x1, uint16_t y1, uint16_t x2, uint16_t y2)
{
	TFT9341_DrawLine(color,x1,y1,x2,y1);
	TFT9341_DrawLine(color,x2,y1,x2,y2);
	TFT9341_DrawLine(color,x1,y1,x1,y2);
	TFT9341_DrawLine(color,x1,y2,x2,y2);
}
//vrati orientaci obrazovky
uint8_t TFT9341_getRotation(void)
{
	return rotationNum;
}
